## sdkconfig.defaults
```kconfig
# MeshCom sdkconfig.defaults

# Bluetooth Classic (HFP AG)
CONFIG_BT_ENABLED=y
CONFIG_BT_CLASSIC_ENABLED=y
CONFIG_BT_HFP_ENABLE=y
CONFIG_BT_HFP_AG_ENABLE=y
CONFIG_BT_SSP_ENABLED=y
CONFIG_BT_BLE_ENABLED=n

# Bluetooth controller
CONFIG_BTDM_CTRL_MODE_BR_EDR_ONLY=y

# WiFi (for ESP-NOW, station mode, no connect)
CONFIG_ESP_WIFI_ENABLED=y

# ESP-NOW
CONFIG_ESP_NOW_ENABLE=y

# NVS
CONFIG_NVS_ENABLED=y

# Partition table
CONFIG_PARTITION_TABLE_CUSTOM=y
CONFIG_PARTITION_TABLE_CUSTOM_FILENAME="partitions.csv"

# mbedTLS (AES-GCM)
CONFIG_MBEDTLS_GCM_C=y
CONFIG_MBEDTLS_AES_C=y

# FreeRTOS
CONFIG_FREERTOS_HZ=1000

# Flash size
CONFIG_ESPTOOLPY_FLASHSIZE_4MB=y

# Log level
CONFIG_LOG_DEFAULT_LEVEL_INFO=y
CONFIG_LOG_DEFAULT_LEVEL=3
```
